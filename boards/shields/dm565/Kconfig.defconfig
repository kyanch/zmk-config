## boards/shields/dm565/Kconfig.defconfig
```kconfig
if SHIELD_DM565_LEFT

    config ZMK_KEYBOARD_NAME
        default "KC DM565(Left)"

endif

if SHIELD_DM565_RIGHT

    config ZMK_KEYBOARD_NAME
        default "KC DM565(Right)"

    config ZMK_SPLIT_ROLE_CENTRAL
        default y
        
endif

if SHIELD_DM565_LEFT || SHIELD_DM565_RIGHT
    config ZMK_SPLIT
        default y

endif
```

## boards/shields/dm565/Kconfig.shield
```kconfig
config SHIELD_DM565_LEFT
    def_bool $(shields_list_contains,dm565_left)

config SHIELD_DM565_RIGHT
    def_bool $(shields_list_contains,dm565_right)
```
